#include "my_keyboard.dtsi"

&default_transform {
    col-offset = <6>; // Offsets the right side by the 6 columns on the left
};

&kscan0 {
    col-gpios
        = <&xiao_d 0 GPIO_ACTIVE_HIGH> // COL0
        , <&xiao_d 1 GPIO_ACTIVE_HIGH> // COL1
        , <&xiao_d 2 GPIO_ACTIVE_HIGH> // COL2
        , <&xiao_d 3 GPIO_ACTIVE_HIGH> // COL3
        , <&xiao_d 4 GPIO_ACTIVE_HIGH> // COL4
        , <&xiao_d 5 GPIO_ACTIVE_HIGH> // COL5
        ;

    row-gpios
        = <&xiao_d 10 (GPIO_ACTIVE_HIGH | GPIO_PULL_DOWN)> // ROW0
        , <&xiao_d 9  (GPIO_ACTIVE_HIGH | GPIO_PULL_DOWN)> // ROW1
        , <&xiao_d 8  (GPIO_ACTIVE_HIGH | GPIO_PULL_DOWN)> // ROW2
        , <&xiao_d 7  (GPIO_ACTIVE_HIGH | GPIO_PULL_DOWN)> // ROW3
        , <&xiao_d 6  (GPIO_ACTIVE_HIGH | GPIO_PULL_DOWN)> // ROW4
        ;
};
